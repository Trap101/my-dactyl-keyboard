## boards/shields/dactyl-manuform/Kconfig.shield
```kconfig
# Copyright (c) 2020 Pete Johanson
# SPDX-License-Identifier: MIT

config SHIELD_DACTYL_LEFT
    def_bool $(shields_list_contains,dactyl_left)

config SHIELD_DACTYL_RIGHT
    def_bool $(shields_list_contains,dactyl_right)
```
